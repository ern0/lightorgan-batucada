void pattern1a() { // batacuda
v( v1 | v2 | __ | v4 | v5 | __ | __ | __ , __ | __ | __ | v4 | __ | __ | __ | __ ); // batacuda
v( __ | __ | v3 | __ | __ | __ | __ | __ , __ | __ | __ | __ | __ | __ | __ | __ ); // batacuda
v( __ | __ | __ | v4 | __ | __ | __ | __ , __ | __ | __ | __ | __ | __ | __ | __ ); // batacuda
v( v1 | __ | __ | v4 | __ | __ | __ | __ , __ | __ | __ | __ | __ | __ | __ | __ ); // batacuda
v( __ | v2 | __ | __ | __ | __ | __ | __ , __ | __ | __ | __ | __ | __ | __ | __ ); // batacuda
v( v1 | __ | v3 | v4 | __ | __ | __ | __ , __ | __ | __ | __ | __ | __ | __ | __ ); // batacuda
v( v1 | __ | __ | v4 | __ | __ | __ | __ , __ | __ | __ | __ | __ | __ | __ | __ ); // batacuda
v( __ | __ | __ | __ | __ | __ | __ | __ , __ | __ | __ | __ | __ | __ | __ | __ ); // batacuda
} // batacuda
void pattern1b() { // batacuda
v( v1 | v2 | v3 | v4 | v5 | v6 | __ | __ , __ | __ | __ | v4 | __ | __ | __ | __ ); // batacuda
v( __ | __ | __ | __ | __ | __ | __ | __ , __ | __ | __ | __ | __ | __ | __ | __ ); // batacuda
v( v1 | __ | __ | v4 | __ | v6 | __ | __ , __ | __ | __ | __ | __ | __ | __ | __ ); // batacuda
v( __ | __ | __ | __ | __ | __ | __ | __ , __ | __ | __ | __ | __ | __ | __ | __ ); // batacuda
v( v1 | v2 | v3 | v4 | __ | v6 | __ | __ , __ | __ | __ | __ | __ | v6 | __ | __ ); // batacuda
v( __ | __ | __ | __ | __ | __ | __ | __ , __ | __ | __ | __ | __ | __ | __ | __ ); // batacuda
} // batacuda
void upbeat1() { // batacuda
v( __ | __ | __ | v4 | __ | __ | __ | __ , __ | __ | __ | __ | __ | __ | __ | __ ); // batacuda
v( __ | __ | __ | v4 | __ | __ | __ | __ , __ | __ | __ | __ | __ | __ | __ | __ ); // batacuda
} // batacuda
void pattern2() { // batacuda
v( v1 | v2 | __ | __ | v5 | __ | __ | __ , __ | v2 | __ | __ | __ | __ | __ | __ ); // batacuda
v( v1 | __ | __ | __ | __ | __ | __ | __ , __ | __ | __ | __ | __ | __ | __ | __ ); // batacuda
v( v1 | __ | __ | __ | v5 | __ | __ | __ , __ | __ | __ | __ | __ | __ | __ | __ ); // batacuda
v( v1 | __ | __ | __ | __ | __ | __ | __ , __ | __ | __ | __ | __ | __ | __ | __ ); // batacuda
v( v1 | __ | __ | __ | v5 | __ | __ | __ , __ | __ | __ | __ | __ | __ | __ | __ ); // batacuda
v( v1 | __ | __ | __ | __ | __ | __ | __ , __ | __ | __ | __ | __ | __ | __ | __ ); // batacuda
v( v1 | v2 | __ | __ | v5 | __ | __ | __ , v1 | v2 | __ | __ | __ | __ | __ | __ ); // batacuda
v( __ | __ | __ | __ | __ | __ | __ | __ , __ | __ | __ | __ | __ | __ | __ | __ ); // batacuda
v( __ | __ | __ | __ | __ | __ | __ | __ , __ | __ | __ | __ | __ | __ | __ | __ ); // batacuda
v( __ | __ | __ | __ | __ | __ | __ | __ , __ | __ | __ | __ | __ | __ | __ | __ ); // batacuda
v( __ | __ | __ | __ | __ | __ | __ | __ , __ | __ | __ | __ | __ | __ | __ | __ ); // batacuda
v( __ | __ | __ | __ | __ | __ | __ | __ , __ | __ | __ | __ | __ | __ | __ | __ ); // batacuda
} // batacuda
void ans1() { // batacuda
v( v1 | v2 | v3 | v4 | __ | __ | v7 | v8 , __ | v2 | v3 | __ | __ | __ | v7 | __ ); // batacuda
v( v1 | __ | __ | v4 | __ | __ | __ | __ , __ | __ | __ | __ | __ | __ | __ | __ ); // batacuda
v( __ | __ | v3 | __ | __ | __ | __ | __ , __ | __ | v3 | __ | __ | __ | __ | __ ); // batacuda
v( v1 | __ | __ | v4 | __ | __ | __ | __ , __ | __ | __ | __ | __ | __ | __ | __ ); // batacuda
v( __ | v2 | v3 | __ | __ | __ | __ | __ , __ | v2 | v3 | __ | __ | __ | __ | __ ); // batacuda
v( v1 | __ | __ | v4 | __ | __ | __ | __ , __ | __ | __ | __ | __ | __ | __ | __ ); // batacuda
v( v1 | __ | __ | v4 | __ | __ | __ | __ , __ | __ | __ | __ | __ | __ | __ | __ ); // batacuda
v( __ | __ | __ | v4 | __ | __ | __ | __ , __ | __ | __ | __ | __ | __ | __ | __ ); // batacuda
} // batacuda
void pre() { // batacuda
v( v1 | __ | __ | __ | __ | __ | __ | __ , __ | __ | __ | __ | __ | __ | __ | __ ); // batacuda
v( v1 | v2 | __ | __ | __ | __ | __ | __ , __ | __ | __ | __ | __ | __ | __ | __ ); // batacuda
v( __ | __ | v3 | __ | __ | __ | __ | __ , __ | __ | __ | __ | __ | __ | __ | __ ); // batacuda
v( __ | v2 | __ | v4 | __ | __ | __ | __ , __ | __ | __ | __ | __ | __ | __ | __ ); // batacuda
v( __ | __ | v3 | __ | v5 | __ | __ | __ , __ | __ | __ | __ | __ | __ | __ | __ ); // batacuda
v( __ | __ | __ | __ | __ | v6 | __ | __ , __ | __ | __ | __ | __ | __ | __ | __ ); // batacuda
v( __ | __ | __ | v4 | __ | __ | v7 | __ , __ | __ | __ | __ | __ | __ | __ | __ ); // batacuda
v( __ | __ | __ | __ | v5 | v6 | __ | v8 , __ | __ | __ | __ | __ | __ | __ | __ ); // batacuda
v( __ | __ | __ | __ | __ | __ | v7 | v8 , __ | __ | __ | __ | __ | __ | __ | __ ); // batacuda
} // batacuda
void batacuda() { // batacuda
v( v1 | v2 | v3 | __ | __ | __ | v7 | __ , v1 | v2 | __ | __ | __ | __ | __ | __ ); // batacuda
v( __ | __ | __ | __ | __ | __ | __ | __ , __ | __ | __ | __ | __ | __ | __ | __ ); // batacuda
v( __ | __ | __ | __ | __ | __ | v7 | __ , __ | __ | __ | __ | __ | __ | __ | __ ); // batacuda
v( __ | __ | __ | __ | __ | __ | __ | __ , __ | __ | __ | __ | __ | __ | __ | __ ); // batacuda
v( __ | v2 | __ | __ | v5 | __ | v7 | __ , __ | v2 | __ | __ | __ | __ | __ | __ ); // batacuda
v( __ | __ | __ | __ | __ | __ | __ | __ , __ | __ | __ | __ | __ | __ | __ | __ ); // batacuda
v( __ | __ | __ | __ | __ | __ | v7 | __ , __ | __ | __ | __ | __ | __ | __ | __ ); // batacuda
v( __ | __ | __ | __ | __ | __ | __ | __ , __ | __ | __ | __ | __ | __ | __ | __ ); // batacuda
v( v1 | v2 | v3 | v4 | v5 | __ | v7 | v8 , v1 | v2 | __ | __ | __ | __ | __ | __ ); // batacuda
v( __ | __ | __ | __ | __ | __ | __ | __ , __ | __ | __ | __ | __ | __ | __ | __ ); // batacuda
v( __ | __ | __ | v4 | __ | __ | v7 | __ , __ | __ | __ | __ | __ | __ | __ | __ ); // batacuda
v( __ | __ | __ | __ | __ | __ | __ | __ , __ | __ | __ | __ | __ | __ | __ | __ ); // batacuda
v( __ | v2 | __ | __ | __ | __ | v7 | __ , __ | v2 | __ | __ | __ | __ | __ | __ ); // batacuda
v( __ | __ | __ | __ | __ | __ | __ | __ , __ | __ | __ | __ | __ | __ | __ | __ ); // batacuda
v( v1 | v2 | v3 | __ | v5 | __ | v7 | v8 , v1 | v2 | __ | __ | __ | __ | __ | __ ); // batacuda
v( __ | __ | __ | __ | __ | __ | __ | __ , __ | __ | __ | __ | __ | __ | __ | __ ); // batacuda
v( __ | __ | __ | __ | __ | __ | v7 | __ , __ | __ | __ | __ | __ | __ | __ | __ ); // batacuda
v( __ | __ | __ | __ | __ | __ | __ | __ , __ | __ | __ | __ | __ | __ | __ | __ ); // batacuda
v( v1 | v2 | __ | __ | v5 | __ | v7 | v8 , v1 | v2 | __ | __ | __ | __ | __ | __ ); // batacuda
v( __ | __ | __ | __ | __ | __ | __ | __ , __ | __ | __ | __ | __ | __ | __ | __ ); // batacuda
v( __ | __ | __ | v4 | v5 | __ | v7 | __ , __ | __ | __ | __ | __ | __ | __ | __ ); // batacuda
v( __ | __ | __ | __ | __ | __ | __ | __ , __ | __ | __ | __ | __ | __ | __ | __ ); // batacuda
v( v1 | v2 | __ | __ | v5 | __ | v7 | v8 , v1 | v2 | __ | __ | __ | __ | __ | __ ); // batacuda
v( __ | __ | __ | __ | __ | __ | __ | __ , __ | __ | __ | __ | __ | __ | __ | __ ); // batacuda
v( v1 | v2 | v3 | v4 | __ | __ | v7 | __ , v1 | v2 | __ | __ | __ | __ | __ | __ ); // batacuda
v( __ | __ | __ | __ | __ | v6 | __ | __ , __ | __ | __ | __ | __ | __ | __ | __ ); // batacuda
v( __ | v2 | __ | __ | __ | v6 | v7 | __ , __ | v2 | __ | __ | __ | __ | __ | __ ); // batacuda
v( __ | __ | __ | __ | __ | __ | __ | __ , __ | __ | __ | __ | __ | __ | __ | __ ); // batacuda
v( v1 | v2 | __ | __ | __ | __ | __ | __ , v1 | v2 | __ | __ | __ | __ | __ | __ ); // batacuda
v( __ | v2 | __ | __ | __ | v6 | __ | __ , __ | v2 | __ | __ | __ | __ | __ | __ ); mut(r1|r2|g1|g2|b1|b2); // batacuda
v( __ | v2 | __ | __ | __ | v6 | __ | __ , __ | v2 | __ | __ | __ | __ | __ | __ ); // batacuda
v( __ | __ | __ | __ | __ | __ | __ | __ , __ | __ | __ | __ | __ | __ | __ | __ ); // batacuda
} // batacuda
void intermission() { // batacuda
v( v1 | v2 | v3 | v4 | __ | __ | __ | __ , v1 | __ | v3 | __ | __ | __ | __ | __ ); // batacuda
v( __ | __ | __ | __ | __ | __ | __ | __ , __ | __ | __ | __ | __ | __ | __ | __ ); // batacuda
v( v1 | v2 | v3 | v4 | __ | __ | __ | __ , v1 | __ | v3 | __ | __ | __ | __ | __ ); // batacuda
v( __ | __ | __ | __ | __ | __ | __ | __ , __ | __ | __ | __ | __ | __ | __ | __ ); // batacuda
v( v1 | v2 | v3 | v4 | __ | __ | __ | __ , v1 | __ | v3 | __ | __ | __ | __ | __ ); // batacuda
v( v1 | v2 | v3 | v4 | __ | __ | __ | __ , v1 | __ | v3 | __ | __ | __ | __ | __ ); // batacuda
v( __ | __ | __ | __ | __ | __ | __ | __ , __ | __ | __ | __ | __ | __ | __ | __ ); // batacuda
v( v1 | v2 | v3 | v4 | __ | __ | __ | __ , v1 | __ | v3 | __ | __ | __ | __ | __ ); // batacuda
v( __ | __ | __ | __ | __ | __ | __ | __ , __ | __ | __ | __ | __ | __ | __ | __ ); // batacuda
v( v1 | v2 | v3 | v4 | __ | __ | __ | __ , v1 | __ | v3 | __ | __ | __ | __ | __ ); // batacuda
v( __ | __ | __ | __ | __ | __ | __ | __ , __ | __ | __ | __ | __ | __ | __ | __ ); // batacuda
v( v1 | v2 | v3 | v4 | __ | __ | __ | __ , v1 | __ | v3 | __ | __ | __ | __ | __ ); // batacuda
v( v1 | v2 | v3 | v4 | __ | __ | __ | __ , v1 | __ | v3 | v4 | __ | __ | __ | __ ); // batacuda
v( __ | __ | v3 | __ | __ | __ | __ | __ , __ | __ | __ | __ | __ | __ | __ | __ ); // batacuda
v( v1 | v2 | __ | __ | __ | __ | __ | __ , v1 | __ | __ | __ | __ | __ | __ | __ ); // batacuda
v( __ | __ | __ | __ | __ | __ | __ | __ , __ | __ | __ | __ | __ | __ | __ | __ ); // batacuda
} // batacuda
