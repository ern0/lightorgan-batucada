void pattern1a() { // batucada
v( v1 | v2 | __ | v4 | v5 | __ | __ | __ , __ | __ | __ | v4 | __ | __ | __ | __ ); // batucada
v( __ | __ | v3 | __ | __ | __ | __ | __ , __ | __ | __ | __ | __ | __ | __ | __ ); // batucada
v( __ | __ | __ | v4 | __ | __ | __ | __ , __ | __ | __ | __ | __ | __ | __ | __ ); // batucada
v( v1 | __ | __ | v4 | __ | __ | __ | __ , __ | __ | __ | __ | __ | __ | __ | __ ); // batucada
v( __ | v2 | __ | __ | __ | __ | __ | __ , __ | __ | __ | __ | __ | __ | __ | __ ); // batucada
v( v1 | __ | v3 | v4 | __ | __ | __ | __ , __ | __ | __ | __ | __ | __ | __ | __ ); // batucada
v( v1 | __ | __ | v4 | __ | __ | __ | __ , __ | __ | __ | __ | __ | __ | __ | __ ); // batucada
v( __ | __ | __ | __ | __ | __ | __ | __ , __ | __ | __ | __ | __ | __ | __ | __ ); // batucada
} // batucada
void pattern1b() { // batucada
v( v1 | v2 | v3 | v4 | v5 | v6 | __ | __ , __ | __ | __ | v4 | __ | __ | __ | __ ); // batucada
v( __ | __ | __ | __ | __ | __ | __ | __ , __ | __ | __ | __ | __ | __ | __ | __ ); // batucada
v( v1 | __ | __ | v4 | __ | v6 | __ | __ , __ | __ | __ | __ | __ | __ | __ | __ ); // batucada
v( __ | __ | __ | __ | __ | __ | __ | __ , __ | __ | __ | __ | __ | __ | __ | __ ); // batucada
v( v1 | v2 | v3 | v4 | __ | v6 | __ | __ , __ | __ | __ | __ | __ | v6 | __ | __ ); // batucada
v( __ | __ | __ | __ | __ | __ | __ | __ , __ | __ | __ | __ | __ | __ | __ | __ ); // batucada
} // batucada
void upbeat1() { // batucada
v( __ | __ | __ | v4 | __ | __ | __ | __ , __ | __ | __ | __ | __ | __ | __ | __ ); // batucada
v( __ | __ | __ | v4 | __ | __ | __ | __ , __ | __ | __ | __ | __ | __ | __ | __ ); // batucada
} // batucada
void pattern2() { // batucada
v( v1 | v2 | __ | __ | v5 | __ | __ | __ , __ | v2 | __ | __ | __ | __ | __ | __ ); // batucada
v( v1 | __ | __ | __ | __ | __ | __ | __ , __ | __ | __ | __ | __ | __ | __ | __ ); // batucada
v( v1 | __ | __ | __ | v5 | __ | __ | __ , __ | __ | __ | __ | __ | __ | __ | __ ); // batucada
v( v1 | __ | __ | __ | __ | __ | __ | __ , __ | __ | __ | __ | __ | __ | __ | __ ); // batucada
v( v1 | __ | __ | __ | v5 | __ | __ | __ , __ | __ | __ | __ | __ | __ | __ | __ ); // batucada
v( v1 | __ | __ | __ | __ | __ | __ | __ , __ | __ | __ | __ | __ | __ | __ | __ ); // batucada
v( v1 | v2 | __ | __ | v5 | __ | __ | __ , v1 | v2 | __ | __ | __ | __ | __ | __ ); // batucada
v( __ | __ | __ | __ | __ | __ | __ | __ , __ | __ | __ | __ | __ | __ | __ | __ ); // batucada
v( __ | __ | __ | __ | __ | __ | __ | __ , __ | __ | __ | __ | __ | __ | __ | __ ); // batucada
v( __ | __ | __ | __ | __ | __ | __ | __ , __ | __ | __ | __ | __ | __ | __ | __ ); // batucada
v( __ | __ | __ | __ | __ | __ | __ | __ , __ | __ | __ | __ | __ | __ | __ | __ ); // batucada
v( __ | __ | __ | __ | __ | __ | __ | __ , __ | __ | __ | __ | __ | __ | __ | __ ); // batucada
} // batucada
void ans1() { // batucada
v( v1 | v2 | v3 | v4 | __ | __ | v7 | v8 , __ | v2 | v3 | __ | __ | __ | v7 | __ ); // batucada
v( v1 | __ | __ | v4 | __ | __ | __ | __ , __ | __ | __ | __ | __ | __ | __ | __ ); // batucada
v( __ | __ | v3 | __ | __ | __ | __ | __ , __ | __ | v3 | __ | __ | __ | __ | __ ); // batucada
v( v1 | __ | __ | v4 | __ | __ | __ | __ , __ | __ | __ | __ | __ | __ | __ | __ ); // batucada
v( __ | v2 | v3 | __ | __ | __ | __ | __ , __ | v2 | v3 | __ | __ | __ | __ | __ ); // batucada
v( v1 | __ | __ | v4 | __ | __ | __ | __ , __ | __ | __ | __ | __ | __ | __ | __ ); // batucada
v( v1 | __ | __ | v4 | __ | __ | __ | __ , __ | __ | __ | __ | __ | __ | __ | __ ); // batucada
v( __ | __ | __ | v4 | __ | __ | __ | __ , __ | __ | __ | __ | __ | __ | __ | __ ); // batucada
} // batucada
void pre() { // batucada
v( v1 | __ | __ | __ | __ | __ | __ | __ , __ | __ | __ | __ | __ | __ | __ | __ ); // batucada
v( v1 | v2 | __ | __ | __ | __ | __ | __ , __ | __ | __ | __ | __ | __ | __ | __ ); // batucada
v( __ | __ | v3 | __ | __ | __ | __ | __ , __ | __ | __ | __ | __ | __ | __ | __ ); // batucada
v( __ | v2 | __ | v4 | __ | __ | __ | __ , __ | __ | __ | __ | __ | __ | __ | __ ); // batucada
v( __ | __ | v3 | __ | v5 | __ | __ | __ , __ | __ | __ | __ | __ | __ | __ | __ ); // batucada
v( __ | __ | __ | __ | __ | v6 | __ | __ , __ | __ | __ | __ | __ | __ | __ | __ ); // batucada
v( __ | __ | __ | v4 | __ | __ | v7 | __ , __ | __ | __ | __ | __ | __ | __ | __ ); // batucada
v( __ | __ | __ | __ | v5 | v6 | __ | v8 , __ | __ | __ | __ | __ | __ | __ | __ ); // batucada
v( __ | __ | __ | __ | __ | __ | v7 | v8 , __ | __ | __ | __ | __ | __ | __ | __ ); // batucada
} // batucada
void batucada() { // batucada
v( v1 | v2 | v3 | __ | __ | __ | v7 | __ , v1 | v2 | __ | __ | __ | __ | __ | __ ); // batucada
v( __ | __ | __ | __ | __ | __ | __ | __ , __ | __ | __ | __ | __ | __ | __ | __ ); // batucada
v( __ | __ | __ | __ | __ | __ | v7 | __ , __ | __ | __ | __ | __ | __ | __ | __ ); // batucada
v( __ | __ | __ | __ | __ | __ | __ | __ , __ | __ | __ | __ | __ | __ | __ | __ ); // batucada
v( __ | v2 | __ | __ | v5 | __ | v7 | __ , __ | v2 | __ | __ | __ | __ | __ | __ ); // batucada
v( __ | __ | __ | __ | __ | __ | __ | __ , __ | __ | __ | __ | __ | __ | __ | __ ); // batucada
v( __ | __ | __ | __ | __ | __ | v7 | __ , __ | __ | __ | __ | __ | __ | __ | __ ); // batucada
v( __ | __ | __ | __ | __ | __ | __ | __ , __ | __ | __ | __ | __ | __ | __ | __ ); // batucada
v( v1 | v2 | v3 | v4 | v5 | __ | v7 | v8 , v1 | v2 | __ | __ | __ | __ | __ | __ ); // batucada
v( __ | __ | __ | __ | __ | __ | __ | __ , __ | __ | __ | __ | __ | __ | __ | __ ); // batucada
v( __ | __ | __ | v4 | __ | __ | v7 | __ , __ | __ | __ | __ | __ | __ | __ | __ ); // batucada
v( __ | __ | __ | __ | __ | __ | __ | __ , __ | __ | __ | __ | __ | __ | __ | __ ); // batucada
v( __ | v2 | __ | __ | __ | __ | v7 | __ , __ | v2 | __ | __ | __ | __ | __ | __ ); // batucada
v( __ | __ | __ | __ | __ | __ | __ | __ , __ | __ | __ | __ | __ | __ | __ | __ ); // batucada
v( v1 | v2 | v3 | __ | v5 | __ | v7 | v8 , v1 | v2 | __ | __ | __ | __ | __ | __ ); // batucada
v( __ | __ | __ | __ | __ | __ | __ | __ , __ | __ | __ | __ | __ | __ | __ | __ ); // batucada
v( __ | __ | __ | __ | __ | __ | v7 | __ , __ | __ | __ | __ | __ | __ | __ | __ ); // batucada
v( __ | __ | __ | __ | __ | __ | __ | __ , __ | __ | __ | __ | __ | __ | __ | __ ); // batucada
v( v1 | v2 | __ | __ | v5 | __ | v7 | v8 , v1 | v2 | __ | __ | __ | __ | __ | __ ); // batucada
v( __ | __ | __ | __ | __ | __ | __ | __ , __ | __ | __ | __ | __ | __ | __ | __ ); // batucada
v( __ | __ | __ | v4 | v5 | __ | v7 | __ , __ | __ | __ | __ | __ | __ | __ | __ ); // batucada
v( __ | __ | __ | __ | __ | __ | __ | __ , __ | __ | __ | __ | __ | __ | __ | __ ); // batucada
v( v1 | v2 | __ | __ | v5 | __ | v7 | v8 , v1 | v2 | __ | __ | __ | __ | __ | __ ); // batucada
v( __ | __ | __ | __ | __ | __ | __ | __ , __ | __ | __ | __ | __ | __ | __ | __ ); // batucada
v( v1 | v2 | v3 | v4 | __ | __ | v7 | __ , v1 | v2 | __ | __ | __ | __ | __ | __ ); // batucada
v( __ | __ | __ | __ | __ | v6 | __ | __ , __ | __ | __ | __ | __ | __ | __ | __ ); // batucada
v( __ | v2 | __ | __ | __ | v6 | v7 | __ , __ | v2 | __ | __ | __ | __ | __ | __ ); // batucada
v( __ | __ | __ | __ | __ | __ | __ | __ , __ | __ | __ | __ | __ | __ | __ | __ ); // batucada
v( v1 | v2 | __ | __ | __ | __ | __ | __ , v1 | v2 | __ | __ | __ | __ | __ | __ ); // batucada
v( __ | v2 | __ | __ | __ | v6 | __ | __ , __ | v2 | __ | __ | __ | __ | __ | __ ); mut(r1|r2|g1|g2|b1|b2); // batucada
v( __ | v2 | __ | __ | __ | v6 | __ | __ , __ | v2 | __ | __ | __ | __ | __ | __ ); // batucada
v( __ | __ | __ | __ | __ | __ | __ | __ , __ | __ | __ | __ | __ | __ | __ | __ ); // batucada
} // batucada
void intermission() { // batucada
v( v1 | v2 | v3 | v4 | __ | __ | __ | __ , v1 | __ | v3 | __ | __ | __ | __ | __ ); // batucada
v( __ | __ | __ | __ | __ | __ | __ | __ , __ | __ | __ | __ | __ | __ | __ | __ ); // batucada
v( v1 | v2 | v3 | v4 | __ | __ | __ | __ , v1 | __ | v3 | __ | __ | __ | __ | __ ); // batucada
v( __ | __ | __ | __ | __ | __ | __ | __ , __ | __ | __ | __ | __ | __ | __ | __ ); // batucada
v( v1 | v2 | v3 | v4 | __ | __ | __ | __ , v1 | __ | v3 | __ | __ | __ | __ | __ ); // batucada
v( v1 | v2 | v3 | v4 | __ | __ | __ | __ , v1 | __ | v3 | __ | __ | __ | __ | __ ); // batucada
v( __ | __ | __ | __ | __ | __ | __ | __ , __ | __ | __ | __ | __ | __ | __ | __ ); // batucada
v( v1 | v2 | v3 | v4 | __ | __ | __ | __ , v1 | __ | v3 | __ | __ | __ | __ | __ ); // batucada
v( __ | __ | __ | __ | __ | __ | __ | __ , __ | __ | __ | __ | __ | __ | __ | __ ); // batucada
v( v1 | v2 | v3 | v4 | __ | __ | __ | __ , v1 | __ | v3 | __ | __ | __ | __ | __ ); // batucada
v( __ | __ | __ | __ | __ | __ | __ | __ , __ | __ | __ | __ | __ | __ | __ | __ ); // batucada
v( v1 | v2 | v3 | v4 | __ | __ | __ | __ , v1 | __ | v3 | __ | __ | __ | __ | __ ); // batucada
v( v1 | v2 | v3 | v4 | __ | __ | __ | __ , v1 | __ | v3 | v4 | __ | __ | __ | __ ); // batucada
v( __ | __ | v3 | __ | __ | __ | __ | __ , __ | __ | __ | __ | __ | __ | __ | __ ); // batucada
v( v1 | v2 | __ | __ | __ | __ | __ | __ , v1 | __ | __ | __ | __ | __ | __ | __ ); // batucada
v( __ | __ | __ | __ | __ | __ | __ | __ , __ | __ | __ | __ | __ | __ | __ | __ ); // batucada
} // batucada
